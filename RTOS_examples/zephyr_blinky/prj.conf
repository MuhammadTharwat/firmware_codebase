## CMakeLists.txt
```
# SPDX-License-Identifier: Apache-2.0
cmake_minimum_required(VERSION 3.20.0)


set(ENV{ZEPHYR_BASE} ${CMAKE_CURRENT_SOURCE_DIR}/../../RTOS/sdk-zephyr)

set(BOARD_ROOT ${CMAKE_CURRENT_SOURCE_DIR}/../../HAL/mcu/32-Bit/Nordic/nRF52/dynastream_nRF52)

set(ZEPHYR_MODULES ${CMAKE_CURRENT_SOURCE_DIR}/../../HAL/mcu/32-Bit/Nordic/hal_nordic/
                    ${CMAKE_CURRENT_SOURCE_DIR}/../../HAL/mcu/32-Bit/Nordic/cmsis/
                    ${CMAKE_CURRENT_SOURCE_DIR}/../../HAL/mcu/32-Bit/Nordic/CMSIS_6/)
find_package(Zephyr REQUIRED HINTS $ENV{ZEPHYR_BASE})

project(Blinky_example LANGUAGES C CXX) 

target_sources(app PRIVATE main_thread/main.cpp
                           ui_thread/ui_thread.cpp)


#### Link ETL library
if(NOT TARGET etl)
add_subdirectory(../../utility/etl ./etl)
endif()
target_link_libraries(app PRIVATE etl::etl)

target_compile_options(app PRIVATE $<$<COMPILE_LANGUAGE:CXX>:-std=c++17>)

target_include_directories(app PRIVATE ui_thread/)

add_custom_target(copy_artifacts ALL
    COMMAND ${CMAKE_COMMAND} -E copy
        ${PROJECT_BINARY_DIR}/zephyr/zephyr.hex
        ${PROJECT_BINARY_DIR}/zephyr/${CMAKE_PROJECT_NAME}-${BOARD}.hex

    COMMAND ${CMAKE_COMMAND} -E copy
        ${PROJECT_BINARY_DIR}/zephyr/zephyr.elf
        ${PROJECT_BINARY_DIR}/zephyr/${CMAKE_PROJECT_NAME}-${BOARD}.elf
)

add_dependencies(copy_artifacts zephyr_final)
```

## prj.conf
```kconfig
CONFIG_GPIO=y
# CONFIG_PM_DEVICE
CONFIG_PM_DEVICE_RUNTIME=y
CONFIG_SIZE_OPTIMIZATIONS=y
CONFIG_PM_DEVICE_RUNTIME=n
# C++ / ETL support
CONFIG_CPP=y
CONFIG_STD_CPP17=y
CONFIG_NEWLIB_LIBC=y
CONFIG_GLIBCXX_LIBCPP=y
```

## src/main.c
```c
#include <stdio.h>
#include <zephyr/kernel.h>
#include <zephyr/drivers/gpio.h>

/* 1000 msec = 1 sec */
#define SLEEP_TIME_MS   1000

#define LED0_NODE DT_NODELABEL(led_a)

/*
 * A build error on this line means your board is unsupported.
 * See the sample documentation for information on how to fix this.
 */
static const struct gpio_dt_spec led = GPIO_DT_SPEC_GET(LED0_NODE, gpios);

int main(void)
{
	int ret;
	bool led_state = true;

	if (!gpio_is_ready_dt(&led))
	{
		return 0;
	}

	ret = gpio_pin_configure_dt(&led, GPIO_OUTPUT_ACTIVE);
	if (ret < 0)
	{
		return 0;
	}

	while (1)
	{
		ret = gpio_pin_toggle_dt(&led);
		if (ret < 0)
		{
			return 0;
		}

		led_state = !led_state;
		printf("LED state: %s\n", led_state ? "ON" : "OFF");
		k_msleep(SLEEP_TIME_MS);
	}
	return 0;
}
```
