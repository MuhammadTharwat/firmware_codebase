## HAL/mcu/32-Bit/Nordic/nRF52/dynastream_nRF52/boards/nordic/dynastream/Kconfig.dynastream
```kconfig
# nRF52833 DK NRF52833 board configuration

# Copyright (c) 2019 Nordic Semiconductor ASA
# SPDX-License-Identifier: Apache-2.0

config BOARD_DYNASTREAM
	select SOC_NRF52832
```

## HAL/mcu/32-Bit/Nordic/nRF52/dynastream_nRF52/boards/nordic/dynastream/board.yml
```yaml
board:
  name: dynastream
  full_name: dynastream DK
  vendor: nordic
  socs:
  - name: nrf52832
```
